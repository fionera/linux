## drivers/rtk_kdriver/Kconfig
```kconfig
menu "Realtek platform dependent drivers"

config RTK_KDRIVER_SUPPORT
    bool "RTK288O platform dependent drivers"
    default n
    depends on ARCH_RTK288O
    select RTK_KDRIVER
    ---help---

config RTK_KDRIVER
    bool
	depends on RTK_KDRIVER_SUPPORT
	default n

#Platform
source "drivers/rtk_kdriver/platform/Kconfig"

#PCBMGR
source "drivers/rtk_kdriver/pcbmgr/Kconfig"

#SCALER
source "drivers/rtk_kdriver/tvscalercontrol/Kconfig"

#HDMI RX
source "drivers/rtk_kdriver/tvscalercontrol/hdmirx/Kconfig"

# RTK_SEMAPHORE
config RTK_SEMAPHORE
	bool "Provide rtk_semaphore for RTK Semaphore"
	default y if !ARCH_RTK299O && !ARCH_RTK289X
	help
	  rtk_semaphore

config RTK_SEMAPHORE_TEST
	bool "Provide test case for RTK Semaphore"
	depends on RTK_SEMAPHORE
	default n

# AMP
# Please notice that this is only for REALTEK_AMP_TAS5711 & REALTEK_AMP_ACL1310
# If use different IC, please change this.
config RTK_KDRV_AMP
	bool "Do AMP_TAS5707 init in kernel STR , if not,do not enable"
	default n
	help
		Amp initial

config RTK_AMP_USER_RESUME
	bool "do RTK Amp AMP_TAS5707 resume() in user resume flow"
	depends on RTK_KDRV_AMP
	default y if RTK_KDRV_AMP
	help
	  Amp resume() happen in user resume flow

#RPC
config RTK_KDRV_RPC
	bool "Use RPC to communicate with Audio & Video."
	default y
	help
	  Use RPC mechanism

# AVCPU
config RTK_KDRV_AVCPU
	bool "AVCPU Driver"
	default n
	help
	  Driver used to control Audio & Video cpu.

# EMCU
config RTK_KDRV_EMCU
	bool "EMCU Driver"
	default y
	help
	  Driver use to control EMCU in standby mode

# WOV
config ENABLE_WOV_SUPPORT
	bool "ENABLE WOV SUPPORT"
	default n
	help
	  Driver use to control wov in standby mode
	  
# RTD LOGBUF
config REALTEK_LOGBUF
	bool "Realtek Logbuf"
	default n
	help
		Support Realtek Logbuf

# USBDUMP
config RTK_USBDUMP_ENABLE
        bool "Realtek usb dump enable"
	depends on REALTEK_LOGBUF
        default n
        help
                Support Realtek usbdump

# ONLINE-HLEP
config RTK_ONLINE_HELP
        bool "Realtek on-line help"
        default y
        help
                Support on-line help

# SB2
config RTK_KDRV_SB2
	bool "SB2 Driver"
	depends on RTK_KDRIVER_SUPPORT
	select RTK_KDRIVER
	default n
	help
	  System Bridge II Driver

# GPIO
source "drivers/rtk_kdriver/gpio/Kconfig"

# PWM
config RTK_KDRV_PWM
	bool "PWM Driver"
	default n
	depends on RTK_KDRIVER_SUPPORT
	select RTK_KDRIVER
	help
	  PWM Device Driver

# IRDA
config RTK_KDRV_IRTX
	bool "IRDA tx Driver"
	default n
	select RTK_KDRV_PWM
	help
	  IRtx Device Driver

# I2C
source drivers/rtk_kdriver/i2c/Kconfig

# PCMCIA
config RTK_KDRV_PCMCIA
	bool "PCMCIA Driver"
	default n
	depends on RTK_KDRIVER_SUPPORT
	select RTK_KDRIVER
	select RTK_KDRV_GPIO
	help
	  PCMCIA Device Driver

# LG BOARD
config RTK_KDRV_LG_BOARD
        bool "LG BOARD arbiter to load one of the PCMCIA and smart card driver"
        default n
        depends on RTK_KDRIVER_SUPPORT
        select RTK_KDRIVER
        help
          LG BOARD arbiter to load one of the PCMCIA and smart card driver"


# LNB UART patch
config RTK_KDRV_LNB_UART
	bool "LG PCB LNB UART patch Driver"
	depends on RTK_KDRIVER_SUPPORT
	select RTK_KDRIVER
	default n
	help
	  LG PCB LNB UART patch Driver

# PINMUX
config RTK_KDRV_PINMUX
        bool "Pinmux Driver"
        default n
        depends on RTK_KDRIVER_SUPPORT
        select RTK_KDRIVER
        help
          Pinmux Driver

#Misc driver
config RTK_KDRV_MISC_DEV
	bool "Misc device Driver"
	default n
	depends on RTK_KDRIVER_SUPPORT
        select RTK_KDRIVER
        help
          Misc Driver

#ETN driver
config RTK_KDRV_R8168
	tristate "Realtek 8168 gigabit ethernet support"
	select FW_LOADER
	select CRC32
	select NET_CORE
	select MII
	select RTK_KDRIVER
	depends on ETHERNET
	depends on RTK_KDRIVER_SUPPORT
	default y if !ARCH_RTK289X
	---help---
	  Say Y here if you have a Realtek 8168 Gigabit Ethernet adapter.

	  To compile this driver as a module, choose M here: the module
	  will be called r8168.  This is recommended.

config RTK_KDRV_8168_EVENT
    	bool "Use kobject link down/up event"
	depends on RTK_KDRV_R8168
    	default n
    	help
      	  If you want to use kobject link down/up event, say Y.


source "drivers/rtk_kdriver/smartcard/Kconfig"
#source "drivers/rtk_kdriver/cec/Kconfig"
source "drivers/rtk_kdriver/rtk_cec/Kconfig"
source "drivers/rtk_kdriver/ddc/Kconfig"
source "drivers/rtk_kdriver/switch/Kconfig"

# OTP : One Time Programming memory
config RTK_KDRV_OTP
	bool "OTP Driver"
	depends on RTK_KDRIVER_SUPPORT
	select RTK_KDRIVER
	default n
	help
	  OTP (One Time Programming) Device

# CW : Control Word
source "drivers/rtk_kdriver/cw/Kconfig"

# RNG : Random Number Generator
config RTK_KDRV_RNG
	bool "RNG (Random Number Generator) Driver."
	depends on RTK_KDRIVER_SUPPORT
	select RTK_KDRIVER
	default n
	help
	  provide HW Random number generator

# CP
source "drivers/rtk_kdriver/mcp/Kconfig"

# DV : Dolbyvision engine
config RTK_KDRV_DV
	bool "DV (Dolbyvision Engine) Driver."
	depends on RTK_KDRIVER_SUPPORT
	select RTK_KDRIVER
	default n
	help
	  Dolbyvision Engine

config DOLBY_IDK_1_6_1_1
	bool "Dolby Vision IDK 1.6.1.1"
	depends on RTK_KDRV_DV
	default n
	help
	  Dolbyvision Engine

config RTK_KDRV_DV_IDK_DUMP
        bool "Dolby Vision IDK DUMP"
        depends on RTK_KDRV_DV
        default n
        help
          Dolbyvision Engine

config SUPPORT_DOLBY_VSIF
        bool "Support Dolby VSIF"
        default n
        help
                Support Dolby VSIF

# MD : Move data engine
config RTK_KDRV_MD
	bool "MD (Move Data Engine) Driver."
	depends on RTK_KDRIVER_SUPPORT
	select RTK_KDRIVER
	default y
	help
	  Move Data engine

# LSADC: Low-speed ADC
config RTK_KDRV_LSADC
	bool "LSADC (Low-speed ADC) Driver."
	depends on RTK_KDRIVER_SUPPORT
	select RTK_KDRIVER
	default n
	help
	  low speed ADC

config RTK_KDRV_MD_TEST
  bool "MD driver test cases"
  depends on RTK_KDRV_MD
  default n
  help
    MD driver test cases

#SPI
config RTK_KDRV_SPI
  bool "SPI driver"
  depends on RTK_KDRIVER_SUPPORT
  default n
  help
    SPI feature support

config RTK_KDRV_SPI_MASTER_GENERAL
  bool "Realtek spi master controler general driver"
  depends on SPI_MASTER && !RTK_KDRV_SPI
  default n
  help
    Enables Realtek SPI controller driver.

#RTC
config RTK_KDRV_RTC
	bool "RTC (Real-Time Clock Engine) Driver."
	depends on RTK_KDRIVER_SUPPORT
	select RTK_KDRIVER
	default n
	help
	  Real-Time Clock feature support

#Watch Dog
config RTK_KDRV_WATCHDOG
	bool "Watch Dog Driver."
	depends on RTK_KDRIVER_SUPPORT
	select RTK_KDRIVER
	default n
	help
	  Watch Dog feature support

#THERMAL
source "drivers/rtk_kdriver/thermal/Kconfig"

#CPU Frequency
config RTK_KDRV_CPU_FREQUENCY
	bool "CPU Frequency Driver"
	depends on RTK_KDRIVER_SUPPORT
	depends on CPU_FREQ
	select RTK_KDRIVER
	default y
	help
	  CPU Frequency

config PV88080_PMIC
	bool "USING PV88080 control power"
	depends on RTK_KDRV_CPU_FREQUENCY
	default n
	help
		SCPU DVS feature support

config REALTEK_ARM_WRAPPER
	bool "ARM WRAPPER Detector Enable"
	default n
	help
	  support ARM WRAPPER Detector

#Memory Trash Detecter
config RTK_KDRV_DC_MEMORY_TRASH_DETCTER
	bool "DCU Memory Trash Detector"
	depends on RTK_KDRIVER_SUPPORT
	select RTK_KDRIVER
	default n
	help
	  Memory Trash Detecter

#QoS Control
config RTK_KDRV_QOS_CONTROL
	bool "QoS Control"
	depends on RTK_KDRIVER_SUPPORT
	select RTK_KDRIVER
	default n
	help
	  QoS Control

#Watch point
config RTK_KDRV_WATCHPOINT
	bool "Simple Hardware Watchpoint"
	depends on HAVE_HW_BREAKPOINT
	default n
	help
	  Simple hardware watchpoint driver

#Frame Buffer
config RTK_KDRV_VENUS_FB
	tristate "RTK Frame Buffer Support"
	select FB
	select FB_CFB_FILLRECT
	select FB_CFB_COPYAREA
	select FB_CFB_IMAGEBLIT
	select FB_SOFT_CURSOR
	select MAGELLAN_CANVAS
	select SET_WIN_ALPHA_AS_FF
	default n
	help
	   Frame buffer driver for Realtek

#RTICE
source "drivers/rtk_kdriver/rtice/Kconfig"

#Voltage
config REALTEK_VOLTAGE_CTRL
	bool "SCPU voltage control"
	default n
	help
	  SCPU Voltage Control.

# IR
source "drivers/rtk_kdriver/ir/Kconfig"

#VGIP ISR
config RTK_KDEV_VGIP_INTERRUPT
	bool "Handle VGIP interrupt in SCPU"
	depends on RTK_KDRIVER_SUPPORT
	select RTK_KDRIVER
	default n
	help
	  handle VGIP interrupt in SCPU.

#VO ISR
config RTK_KDEV_VO_INTERRUPT
        bool "Handle VO interrupt in SCPU(JUST FOR IC VERIFY, DON'T ENABLE IT!!)"
        depends on RTK_KDRIVER_SUPPORT
        select RTK_KDRIVER
        default n
        help
          handle VO interrupt in SCPU. (JUST FOR IC VERIFY, DON'T ENABLE IT!!)

#MEMC ISR
config RTK_KDEV_MEMC_INTERRUPT
	bool "Handle MEMC interrupt in SCPU"
	depends on RTK_KDRIVER_SUPPORT
	select RTK_KDRIVER
	default n
	help
		handle MEMC interrupt in SCPU.

#ISR Debug
config RTK_KDEV_DEBUG_ISR
	bool "Handle Debug MEMC interrupt in SCPU"
	depends on RTK_KDRIVER_SUPPORT
	select RTK_KDRIVER
	default n
	help
		handle Debug MEMC interrupt in SCPU.

#I2run function
config I2RND_ENABLE
	bool "CONFIG_I2RND_ENABLE"
	default n
	help
		enable i2run function

config PST_ENABLE
	bool "CONFIG_PST_ENABLE"
	default y
	help
		enable pst function

config REALTEK_INT_MICOM
        bool "CONFIG_REALTEK_INT_MICOM"
        default n
        help
                support Internal Micom function

#USB HCD platform
source "drivers/rtk_kdriver/usb/Kconfig"

comment "DTV Related Drivers"

source "drivers/rtk_kdriver/demod/Kconfig"
source "drivers/rtk_kdriver/tp/Kconfig"
source "drivers/rtk_kdriver/atsc3_dmx/Kconfig"

comment "HAL Drivers"

source "drivers/rtk_kdriver/demux/Kconfig"
source "drivers/rtk_kdriver/audio/Kconfig"
source "drivers/rtk_kdriver/vdec/Kconfig"
source "drivers/rtk_kdriver/dmabuf/Kconfig"
source "drivers/rtk_kdriver/vutils/Kconfig"
source "drivers/rtk_kdriver/v4l2_vcodec/Kconfig"
source "drivers/rtk_kdriver/teeproxy/Kconfig"
source "drivers/rtk_kdriver/directvo/Kconfig"
source "drivers/rtk_kdriver/audio_hw/Kconfig"

comment "GAL realted Drivers"
source "drivers/rtk_kdriver/gal/Kconfig"

comment "RTK Uart Drivers"
source "drivers/rtk_kdriver/uart/Kconfig"

comment "LGTV related"
source "drivers/rtk_kdriver/lgtv_driver_proc/Kconfig"
###################################################################
# DTV Related drivers
###################################################################

endmenu
```

## drivers/rtk_kdriver/audio/Kconfig
```kconfig
config RTK_KDRV_AUDIO
	bool "Driver for Audio HAL Manager"
	depends on RTK_KDRV_RPC
	default n
	help
	  Driver for Audio HAL Manager

config ALSA_LGSE_VERSION
        int "LGE lgse version for Audio alsa-ext header"
        depends on RTK_KDRV_RPC
        default 63
        help
          LGE lgse version for Audio alsa-ext header
```

## drivers/rtk_kdriver/cec/adapter/Kconfig
```kconfig
#Copyright (C) 2007-2013 Realtek Semiconductor Corporation.
# drivers/Kconfig

menu "CEC Adapters"	
	depends on RTK_KDRV_CEC

endmenu
```

## drivers/rtk_kdriver/directvo/Kconfig
```kconfig
config RTK_KDRV_DVO
	bool "Driver for DirectVO"
	depends on RTK_KDRV_RPC
	default n
	help
	  Driver for DirectVO
```

## drivers/rtk_kdriver/dmabuf/Kconfig
```kconfig
config RTK_KDRV_DMABUF
	tristate "Driver for DMA buffer Manager"
	default y
	help
	  Driver for DMA buffer Manager
```

## drivers/rtk_kdriver/lgtv_driver_proc/Kconfig
```kconfig
menu "LGTV driver procfs support"

config LGTV_DRIVER_PROCFS_SUPPORT
	bool "Enable LGTV Driver Procfs Support"
	default n
	help
		"export driver debug information to /proc/lgtv-driver"
		
endmenu
```

## drivers/rtk_kdriver/platform/Kconfig
```kconfig
source "drivers/rtk_kdriver/platform/tv006/Kconfig"
source "drivers/rtk_kdriver/platform/tv006/panel_error_detect/Kconfig"
```

## drivers/rtk_kdriver/platform/tv006/panel_error_detect/Kconfig
```kconfig
menu "platform dependent drivers (TV006)"
depends on CUSTOMER_TV006

config RTK_PANEL_ERROR_DETECT
        bool "Enable GPIO Interrupt for Panel error detect"
        select RTK_KDRV_GPIO
        default n

endmenu
```

## drivers/rtk_kdriver/rtk_cec/Kconfig
```kconfig
#Copyright (C) 2007-2013 Realtek Semiconductor Corporation.
# drivers/cec/Kconfig

config RTK_KDRV_CEC
	bool "rtk cec driver based on cec framework"
	default n
	select MEDIA_CEC_SUPPORT
	---help---
	  rtk cec driver based on cec framework
	
```

## drivers/rtk_kdriver/v4l2_vcodec/Kconfig
```kconfig
config RTK_KDRV_V4L2_VCODEC
	tristate "Realtek V4L2 video codec driver"
	depends on RTK_KDRV_RPC
	select RTK_KDRV_VUTILS
	select V4L2_MEM2MEM_DEV
	select VIDEOBUF2_DMA_CONTIG
	default n
```

## drivers/rtk_kdriver/vdec/Kconfig
```kconfig
config RTK_KDRV_VDEC
	bool "Driver for VDEC HAL Manager"
	depends on RTK_KDRV_RPC
	default n
	help
	  Driver for VDEC HAL Manager
```

## drivers/smartcard/Kconfig
```kconfig
# drivers/cec/Kconfig

menu "Smart Card Interface Support"

config SMARTCARD
	tristate "Smart Card Interface Support"
	depends on !RTK_KDRIVER_SUPPORT
	default n
	help
	  Say Y here if you want to support smart card on your platform

source drivers/smartcard/core/Kconfig
source drivers/smartcard/adapter/Kconfig

endmenu
```

## drivers/smartcard/adapter/Kconfig
```kconfig
# drivers/Kconfig

comment"Smart Card Interface"
	depends on SMARTCARD

config SMARTCARD_IFD
	tristate "Smart Card Interface"
	depends on SMARTCARD && (ARCH_RTK299S || ARCH_RTKS2B || ARCH_RTK299O || ARCH_RTK293x || ARCH_RTK289X)
	default n
	help
	  If you want to use smart card on board, say Y.
```
