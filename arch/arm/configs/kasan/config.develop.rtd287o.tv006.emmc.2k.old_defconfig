## arch/arm64/configs/realtek/config.develop.rtd287o64.tv006.emmc.2k.old_defconfig
```kconfig
# CONFIG_ARM_PATCH_PHYS_VIRT is not set
CONFIG_PHYS_OFFSET=0x00000000
CONFIG_CROSS_COMPILE="aarch64-starfish-linux-"
# CONFIG_LOCALVERSION_AUTO is not set
CONFIG_SYSVIPC=y
CONFIG_POSIX_MQUEUE=y
CONFIG_NO_HZ=y
CONFIG_HIGH_RES_TIMERS=y
CONFIG_BSD_PROCESS_ACCT=y
CONFIG_TASKSTATS=y
CONFIG_TASK_DELAY_ACCT=y
CONFIG_TASK_XACCT=y
CONFIG_TASK_IO_ACCOUNTING=y
CONFIG_IKCONFIG=y
CONFIG_IKCONFIG_PROC=y
CONFIG_LOG_BUF_SHIFT=18
CONFIG_CGROUPS=y
CONFIG_CGROUP_DEBUG=y
CONFIG_CGROUP_FREEZER=y
CONFIG_CGROUP_DEVICE=y
CONFIG_CPUSETS=y
CONFIG_CGROUP_CPUACCT=y
CONFIG_MEMCG=y
CONFIG_MEMCG_SWAP=y
CONFIG_MEMCG_KMEM=y
CONFIG_CGROUP_PERF=y
CONFIG_CGROUP_SCHED=y
CONFIG_BLK_CGROUP=y
CONFIG_CC_OPTIMIZE_FOR_SIZE=y
CONFIG_KALLSYMS_ALL=y
CONFIG_EMBEDDED=y
CONFIG_PERF_EVENTS=y
CONFIG_MODULES=y
CONFIG_MODULE_FORCE_LOAD=y
CONFIG_MODULE_UNLOAD=y
CONFIG_MODULE_FORCE_UNLOAD=y
CONFIG_MODULE_SRCVERSION_ALL=y
# CONFIG_BLK_DEV_BSG is not set
CONFIG_PARTITION_ADVANCED=y
CONFIG_LGEMMC_PARTITION=y
CONFIG_CFQ_GROUP_IOSCHED=y
CONFIG_ARCH_RTK287O=y
CONFIG_SUPPORT_SCALER=y
CONFIG_RTK_KDRV_AVCPU=y
CONFIG_REALTEK_LOGBUF=y
CONFIG_RTK_USBDUMP_ENABLE=y
CONFIG_RTK_KDRV_SB2=y
CONFIG_RTK_KDRV_GPIO_WDT_DEBUG_LOG=y
CONFIG_RTK_KDRV_CEC=y
CONFIG_RTK_KDRV_CEC_CHARDEV=y
# CONFIG_RTK_KDRV_CEC_DEBUG is not set
CONFIG_RTK_KDRV_PWM=y
CONFIG_RTK_KDRV_I2C_ALGO_RTK=y
CONFIG_RTK_KDRV_I2C=y
CONFIG_RTK_KDRV_I2C_HW_SEMAPHORE_SUPPORT=y
CONFIG_RTK_KDRV_I2C_SKIP_ISO_CLK_FOR_MICOM=y
CONFIG_REALTEK_INT_MICOM=y
CONFIG_RTK_KDRV_PCMCIA=y
CONFIG_RTK_KDRV_LG_BOARD=y
CONFIG_RTK_KDRV_LNB_UART=y
CONFIG_RTK_KDRV_PINMUX=y
CONFIG_RTK_KDRV_MISC_DEV=y
CONFIG_RTK_KDRV_OTP=y
CONFIG_RTK_KDRV_HDCP_KEY_FROM_OTP=y
CONFIG_RTK_KDRV_RNG=y
CONFIG_RTK_KDRV_MCP=y
CONFIG_RTK_KDRV_MCP_NAPI=y
CONFIG_RTK_KDRV_MCP_SHA256=y
#CONFIG_RTK_KDRV_DV=n
CONFIG_RTK_KDRV_MD=y
CONFIG_RTK_KDRV_RTC=y
CONFIG_RTK_KDRV_CEC=y
CONFIG_RTK_KDRV_CEC_CHARDEV=y
CONFIG_RTK_KDRV_WATCHDOG=y
CONFIG_RTK_KDRV_THERMAL=y
CONFIG_RTK_KDRV_THERMAL_GOV_RTK_THERMAL_THROTTLE=y
CONFIG_RTK_KDRV_THERMAL_DEFAULT_GOV_RTK_THERMAL=y
CONFIG_RTK_KDRV_THERMAL_SENSOR=y
CONFIG_RTK_KDRV_DC_MEMORY_TRASH_DETCTER=y
CONFIG_RTK_KDRV_QOS_CONTROL=y
CONFIG_RTK_KDRV_RTICE=y
CONFIG_RTK_KDEV_VGIP_INTERRUPT=y
# CONFIG_RTK_KDRV_IR is not set
CONFIG_RTK_KDEV_MEMC_INTERRUPT=y
CONFIG_RTK_KDRV_USB=y
CONFIG_RTK_KDRV_XHCI_HCD_PLATFORM=y
CONFIG_RTK_KDRV_EHCI_HCD_PLATFORM=y
CONFIG_RTK_KDRV_OHCI_HCD_PLATFORM=y
CONFIG_RTK_KDRV_TP=y
CONFIG_RTK_KDRV_ATSC3_DMX=y
CONFIG_RTK_KDRV_DEMUX=y
CONFIG_RTK_KDRV_AUDIO=y
CONFIG_RTK_KDRV_VDEC=y
CONFIG_RTK_KDRV_AUDIO_HW=y
CONFIG_RTK_KDRV_SE=y
CONFIG_RTK_KDRV_GDMA=y
CONFIG_RTK_KDRV_GAL=y
CONFIG_RTK_KDRV_SERIAL_8250=y
CONFIG_RTK_KDRV_SERIAL_8250_EXTENDED=y
CONFIG_RTK_KDRV_SERIAL_8250_CONSOLE=y
CONFIG_RTK_KDRV_SERIAL_8250_NR_UARTS=32
CONFIG_RTK_KDRV_SERIAL_8250_RUNTIME_UARTS=2
CONFIG_RTK_KDRV_SERIAL_8250_MANY_PORTS=y
CONFIG_RTK_KDRV_SERIAL_8250_SHARE_IRQ=y
CONFIG_RTK_KDRV_SERIAL_8250_DETECT_IRQ=y
CONFIG_RTK_KDRV_SERIAL_8250_RSA=y
CONFIG_REALTEK_SECURE=y
CONFIG_REALTEK_POWER_CUT=y
CONFIG_REALTEK_DEV_MEM=y
CONFIG_REALTEK_MANAGE_OVERLAPPED_REGION=y
CONFIG_REALTEK_PCBMGR=y
CONFIG_REALTEK_2K_MODEL_ENABLED=y
CONFIG_REALTEK_ARM_WRAPPER=y
CONFIG_CUSTOMER_TV006=y
CONFIG_ARM_THUMBEE=y
CONFIG_ARM_ERRATA_720789=y
CONFIG_OPTEE=y
CONFIG_SMP=y
CONFIG_SCHED_MC=y
CONFIG_SCHED_SMT=y
CONFIG_HAVE_ARM_ARCH_TIMER=y
CONFIG_VMSPLIT_3G_OPT=y
CONFIG_PREEMPT=y
CONFIG_AEABI=y
CONFIG_OABI_COMPAT=y
CONFIG_HIGHMEM=y
# CONFIG_HIGHPTE is not set
CONFIG_CMA=y
CONFIG_CMA_DEBUGFS=y
# CONFIG_CMA_POPULATE is not set
CONFIG_CMA_ANON=y
CONFIG_CMA_ZSPAGES=y
CONFIG_CMA_OFF_ALLOC_FAIR=y
CONFIG_ZSMALLOC=y
CONFIG_PGTABLE_MAPPING=y
CONFIG_USE_OF=y
CONFIG_BUILD_ARM_APPENDED_DTB_IMAGE_EXT=y
CONFIG_BUILD_ARM_APPENDED_DTB_IMAGE_NAMES_EXT="rtd287o.dtb"
CONFIG_ARM_ATAG_DTB_COMPAT_EXT=y
CONFIG_ZBOOT_ROM_TEXT=0x0
CONFIG_ZBOOT_ROM_BSS=0x0
CONFIG_CMDLINE="mem=256M console=ttyS0,115200 earlyprintk"
CONFIG_KEXEC=y
CONFIG_AUTO_ZRELADDR=y
# CONFIG_CPU_FREQ is not set
# CONFIG_CPU_FREQ_STAT_DETAILS is not set
# CONFIG_CPU_FREQ_GOV_POWERSAVE is not set
# CONFIG_CPU_FREQ_GOV_USERSPACE is not set
# CONFIG_CPU_FREQ_GOV_ONDEMAND is not set
# CONFIG_CPU_FREQ_GOV_INTERACTIVE is not set
# CONFIG_CPU_FREQ_GOV_CONSERVATIVE is not set
CONFIG_FPE_NWFPE=y
CONFIG_VFP=y
CONFIG_NEON=y
CONFIG_BINFMT_MISC=y
CONFIG_COMPAT=y
CONFIG_HIBERNATION=y
CONFIG_LG_SNAPSHOT_BOOT=y
CONFIG_SNAPSHOT_IMAGE_COMPRESSION=y
CONFIG_SNAPSHOT_COMPRESS_TYPE="lz4"
CONFIG_LG_INSTANT_BOOT=y
CONFIG_LG_INSTANT_DENY_PM_TEST=y
CONFIG_PM_DEBUG=y
CONFIG_DPM_WATCHDOG=y
CONFIG_DPM_WATCHDOG_TIMEOUT=3
CONFIG_NET=y
CONFIG_PACKET=y
CONFIG_UNIX=y
CONFIG_UNIX_DIAG=y
CONFIG_INET=y
CONFIG_IP_MULTICAST=y
CONFIG_IP_ADVANCED_ROUTER=y
CONFIG_IP_FIB_TRIE_STATS=y
CONFIG_IP_MULTIPLE_TABLES=y
CONFIG_IP_ROUTE_MULTIPATH=y
CONFIG_IP_PNP=y
CONFIG_BRIDGE=y
CONFIG_WIRELESS_EXT=y
CONFIG_WEXT_PRIV=y
CONFIG_CFG80211=y
CONFIG_NL80211_TESTMODE=y
CONFIG_CFG80211_DEVELOPER_WARNINGS=y
CONFIG_CFG80211_REG_DEBUG=y
CONFIG_CFG80211_CERTIFICATION_ONUS=y
# CONFIG_CFG80211_DEFAULT_PS is not set
CONFIG_MAC80211=y
CONFIG_MAC80211_MESH=y
CONFIG_MAC80211_MESSAGE_TRACING=y
CONFIG_MAC80211_DEBUG_MENU=y
CONFIG_UEVENT_HELPER_PATH="/mnt/lg/bin/hotplug"
CONFIG_DEVTMPFS=y
CONFIG_DEVTMPFS_MOUNT=y
CONFIG_FW_LOADER_USER_HELPER_FALLBACK=y
CONFIG_DMA_CMA=y
# CONFIG_CMA_FIRST_POLICY is not set
CONFIG_CONNECTOR=y
CONFIG_REALTEK_OF=y
CONFIG_ZRAM=y
CONFIG_BLK_DEV_LOOP=y
CONFIG_BLK_DEV_LOOP_MIN_COUNT=0
CONFIG_SCSI=y
# CONFIG_SCSI_PROC_FS is not set
CONFIG_BLK_DEV_SD=y
CONFIG_CHR_DEV_SG=y
CONFIG_SCSI_SCAN_ASYNC=y
CONFIG_NETDEVICES=y
CONFIG_TUN=y
# CONFIG_NET_CADENCE is not set
# CONFIG_NET_VENDOR_BROADCOM is not set
# CONFIG_NET_VENDOR_CIRRUS is not set
# CONFIG_NET_VENDOR_FARADAY is not set
# CONFIG_NET_VENDOR_INTEL is not set
# CONFIG_NET_VENDOR_MARVELL is not set
# CONFIG_NET_VENDOR_MICREL is not set
# CONFIG_NET_VENDOR_NATSEMI is not set
CONFIG_ETHOC=y
# CONFIG_NET_VENDOR_SMSC is not set
# CONFIG_NET_VENDOR_STMICRO is not set
# CONFIG_NET_VENDOR_WIZNET is not set
CONFIG_PPP=y
CONFIG_PPP_BSDCOMP=y
CONFIG_PPP_DEFLATE=y
CONFIG_PPP_ASYNC=y
CONFIG_PPP_SYNC_TTY=y
CONFIG_USB_USBNET=y
# CONFIG_USB_NET_AX88179_178A is not set
# CONFIG_USB_NET_CDCETHER is not set
# CONFIG_USB_NET_CDC_NCM is not set
# CONFIG_USB_NET_NET1080 is not set
# CONFIG_USB_NET_CDC_SUBSET is not set
# CONFIG_USB_NET_ZAURUS is not set
# CONFIG_RTL_CARDS is not set
# CONFIG_INPUT_MOUSEDEV_PSAUX is not set
CONFIG_INPUT_MOUSEDEV_SCREEN_X=1280
CONFIG_INPUT_MOUSEDEV_SCREEN_Y=720
CONFIG_INPUT_JOYDEV=y
CONFIG_INPUT_EVDEV=y
# CONFIG_INPUT_MOUSE is not set
CONFIG_INPUT_JOYSTICK=y
CONFIG_JOYSTICK_XPAD=y
CONFIG_JOYSTICK_XPAD_FF=y
CONFIG_INPUT_MISC=y
CONFIG_INPUT_UINPUT=y
CONFIG_DEVPTS_MULTIPLE_INSTANCES=y
CONFIG_LEGACY_PTY_COUNT=8
# CONFIG_HW_RANDOM is not set
# CONFIG_I2C_COMPAT is not set
# CONFIG_I2C_HELPER_AUTO is not set
# CONFIG_HWMON is not set
CONFIG_THERMAL=y
CONFIG_REGULATOR=y
CONFIG_MEDIA_SUPPORT=y
CONFIG_MEDIA_CAMERA_SUPPORT=y
CONFIG_MEDIA_DIGITAL_TV_SUPPORT=y
CONFIG_MEDIA_USB_SUPPORT=y
CONFIG_USB_VIDEO_CLASS=y
# CONFIG_USB_GSPCA is not set
CONFIG_DRM=y
# CONFIG_DRM_I2C_NXP_TDA998X is not set
CONFIG_DRM_TILCDC=y
CONFIG_SOUND=y
CONFIG_SND=y
CONFIG_SND_MIXER_OSS=y
CONFIG_SND_PCM_OSS=y
CONFIG_SND_KDRV_REALTEK=y
CONFIG_SND_USB_AUDIO=y
CONFIG_HIDRAW=y
CONFIG_UHID=y
CONFIG_HID_LOGITECH=y
CONFIG_LOGITECH_FF=y
CONFIG_LOGIRUMBLEPAD2_FF=y
CONFIG_HID_SONY=y
CONFIG_SONY_DUALSHOCK_4_USER_DRIVER=y
CONFIG_HID_PID=y
CONFIG_USB_HIDDEV=y
CONFIG_USB_XHCI_HCD=y
CONFIG_USB_EHCI_HCD=y
CONFIG_USB_OHCI_HCD=y
CONFIG_USB_HCD_TEST_MODE=y
CONFIG_USB_ACM=y
CONFIG_USB_STORAGE=y
CONFIG_USB_STORAGE_SCAN_HELPER_PATH="/mnt/lg/bin/read_scan_complete"
CONFIG_USB_SERIAL=y
CONFIG_USB_SERIAL_CONSOLE=y
CONFIG_USB_SERIAL_GENERIC=y
CONFIG_USB_SERIAL_PL2303=y
CONFIG_USB_SERIAL_SIERRAWIRELESS=y
CONFIG_USB_SERIAL_OPTION=y
CONFIG_MMC=y
CONFIG_MMC_BLOCK_MINORS=64
CONFIG_MMC_RTKEMMC_PLUS=y
CONFIG_RTKEMMC_HS200=y
CONFIG_RTKEMMC_HS400=y
CONFIG_RTKEMMC_HS200_CLOCK=200
CONFIG_MMC_RTKEMMC_HK_ATTR=y
CONFIG_MMC_RTKEMMC_VENDOR_IOCTL=y
CONFIG_NEW_LEDS=y
CONFIG_LEDS_CLASS=y
CONFIG_STAGING=y
CONFIG_ION=y
CONFIG_ION_REALTEK=y
CONFIG_WEBOS=y
CONFIG_LOW_MEM_NOTIFY=y
CONFIG_PM_DEVFREQ=y
CONFIG_DEVFREQ_GOV_SIMPLE_ONDEMAND=y
CONFIG_PWM=y
# CONFIG_LG_BUILTIN_KDRIVER is not set
CONFIG_TEE=y
CONFIG_EXT2_FS=y
CONFIG_EXT3_FS=y
CONFIG_EXT4_FS_POSIX_ACL=y
CONFIG_EXT4_FS_SECURITY=y
CONFIG_FUSE_FS=y
CONFIG_CUSE=y
CONFIG_OVERLAY_FS=y
CONFIG_MSDOS_FS=y
CONFIG_VFAT_FS=y
CONFIG_NTFS_FS=y
CONFIG_NTFS_RW=y
CONFIG_TMPFS=y
CONFIG_ECRYPT_FS=y
CONFIG_SQUASHFS=y
CONFIG_SQUASHFS_FILE_DIRECT=y
CONFIG_SQUASHFS_XATTR=y
CONFIG_SQUASHFS_LZO=y
CONFIG_SQUASHFS_XZ=y
CONFIG_SQUASHFS_4K_DEVBLK_SIZE=y
CONFIG_SQUASHFS_EMBEDDED=y
CONFIG_NFS_FS=y
CONFIG_NFS_V4=y
CONFIG_ROOT_NFS=y
CONFIG_CIFS=y
# CONFIG_CIFS_DEBUG is not set
CONFIG_NLS_CODEPAGE_437=y
CONFIG_NLS_ISO8859_1=y
CONFIG_NLS_UTF8=y
CONFIG_PRINTK_TIME=y
CONFIG_DYNAMIC_DEBUG=y
CONFIG_DEBUG_INFO=y
CONFIG_PAGE_OWNER=y
CONFIG_CMA_TRACK_USE_PAGE_OWNER=y
CONFIG_MAGIC_SYSRQ=y
CONFIG_SCHEDSTATS=y
CONFIG_TIMER_STATS=y
CONFIG_DEBUG_MUTEXES=y
CONFIG_RCU_CPU_STALL_TIMEOUT=60
CONFIG_FTRACE_SYSCALLS=y
CONFIG_DEBUG_USER=y
CONFIG_DEBUG_LL=y
CONFIG_DEBUG_LL_UART_8250=y
CONFIG_DEBUG_UART_PHYS=0x18062300
CONFIG_DEBUG_UART_VIRT=0xfe062300
CONFIG_EARLY_PRINTK=y
CONFIG_ENCRYPTED_KEYS=y
CONFIG_SECURITY=y
CONFIG_SECURITYFS=y
CONFIG_SECURITY_NETWORK=y
CONFIG_CRYPTO_MICHAEL_MIC=y
CONFIG_CRYPTO_DEFLATE=y
CONFIG_CRYPTO_LZ4=y
CONFIG_CRC_T10DIF=y
CONFIG_CRC_ITU_T=y
CONFIG_CRC7=y
CONFIG_LIBCRC32C=y
CONFIG_RTK_KDRV_KHAL_DEMOD=y
CONFIG_RTK_KDRV_DEMOD_SCAN_THREAD_ENABLE=y
#CONFIG_ENABLE_DOLBY_VISION_HDMI_AUTO_DETECT is not set
CONFIG_ENABLE_HDR10_HDMI_AUTO_DETECT=y
#CONFIG_USE_SHARE_COMMON=y
CONFIG_KDRIVER_USE_NEW_COMMON=y
CONFIG_RTK_KDRIVER_SUPPORT=y
```

## drivers/cec/adapter/Kconfig
```kconfig
#Copyright (C) 2007-2013 Realtek Semiconductor Corporation.
# drivers/Kconfig

menu "CEC Adapters"	
	depends on CEC

config RTD299x_CEC
	tristate "CEC Controller for Realtek RTD29xx platform"
	depends on CEC 
	default n
	help
	  Say Y, if you want to enable CEC feature on Realtek RTD299x/298x/294x platform.

endmenu
```

## drivers/media/platform/lg1k/Kconfig
```kconfig
config CEC_LG1K
	bool "cec controller drivers for LG1K DTV SoCs"
	depends on V4L_PLATFORM_DRIVERS

	help
	  Select this to enable the cec controller drivers for LG1K
	  DTV SoCs. Currently supports LG1211, LG1212, LG1313, and
	  LG1314.
```

## drivers/pinctrl/lg1k/Kconfig
```kconfig
config PINCTRL_LG1K
	bool "Pin controller drivers for LG1K DTV SoCs"
	depends on ARCH_LG1K
	select PINMUX
	select PINCONF
	select GENERIC_PINCONF
	help
	  Select this to enable the pin controller drivers for LG1K
	  DTV SoCs. Currently supports LG1211, LG1212, LG1313, and
	  LG1314.
```
